## esp-csi/examples/esp-radar/wifi_sensing_demo/main/Kconfig.projbuild
```kconfig
menu "Wi-Fi sensing demo"

choice ESP_WIFI_SENSING_DEMO_LED_TYPE
    prompt "LED type"
    default ESP_WIFI_SENSING_DEMO_LED_TYPE_GPIO
    help
        Choose between a single GPIO LED and a single WS2812 LED.

    config ESP_WIFI_SENSING_DEMO_LED_TYPE_GPIO
        bool "GPIO LED"

    config ESP_WIFI_SENSING_DEMO_LED_TYPE_WS2812
        bool "WS2812 LED"
endchoice

config ESP_WIFI_SENSING_DEMO_LED_GPIO
    int "LED GPIO"
    default 2
    help
        GPIO used for the LED output. For WS2812 this is the data pin.

if ESP_WIFI_SENSING_DEMO_LED_TYPE_WS2812

choice ESP_WIFI_SENSING_DEMO_WS2812_BACKEND
    prompt "WS2812 backend"
    default ESP_WIFI_SENSING_DEMO_WS2812_BACKEND_RMT
    help
        Select the peripheral used to drive the WS2812 LED.

    config ESP_WIFI_SENSING_DEMO_WS2812_BACKEND_RMT
        bool "RMT backend"

    config ESP_WIFI_SENSING_DEMO_WS2812_BACKEND_SPI
        bool "SPI backend"
endchoice

endif

endmenu
```

## esp-csi/examples/get-started/csi_recv/main/Kconfig.projbuild
```kconfig
menu "CSI Receive Configuration"

    config CSI_PUBLIC_WIFI_SSID
        string "Public Wi-Fi SSID"
        default ""
        help
            SSID used by csi_recv to connect the public/local Wi-Fi network
            that carries UDP CSI packets.

    config CSI_PUBLIC_WIFI_PASSWORD
        string "Public Wi-Fi password"
        default ""
        help
            Password for the public/local Wi-Fi network.

    config CSI_AP_CHANNEL
        int "CSI SoftAP channel"
        range 1 13
        default 11
        help
            Set this to the channel used by the public Wi-Fi AP.
            Both interfaces must use the same channel in APSTA mode.

    config CSI_UDP_PORT
        int "UDP destination port"
        range 1 65535
        default 5005

    config CSI_UDP_TARGET_IP
        string "UDP destination IP"
        default "255.255.255.255"
        help
            Set to 255.255.255.255 for LAN broadcast, or set a specific
            computer/server IP for unicast.

endmenu
```
